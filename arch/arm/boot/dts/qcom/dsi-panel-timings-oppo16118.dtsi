/* OPPO 16118 panel timing overrides */

&dsi_oppo16051samsung_s6e3fa3_1080p_cmd {
	qcom,mdss-dsi-panel-timings-phy-v2 = [24 1f 08 09 05 03 04 a0 24 1f 08 09 05 03 04 a0 24 1f 08 09 05 03 04 a0 24 1f 08 09 05 03 04 a0 24 1a 08 09 05 03 04 a0];
};

&dsi_oppo16103jdi_r63452_1080p_cmd {
	qcom,mdss-dsi-panel-timings-phy-v2 = [24 1f 08 09 05 03 04 a0 24 1f 08 09 05 03 04 a0 24 1f 08 09 05 03 04 a0 24 1f 08 09 05 03 04 a0 24 1b 08 09 05 03 04 a0];
};

&dsi_oppo16118samsung_s6e3fa3_1080p_cmd {
	qcom,mdss-dsi-panel-timings-phy-v2 = [24 1f 08 09 06 03 04 a0 24 1f 08 09 06 03 04 a0 24 1f 08 09 06 03 04 a0 24 1f 08 09 06 03 04 a0 24 1b 08 09 06 03 04 a0];
};

&dsi_oppo17011samsung_sofeg01_s_1080p_cmd {
	qcom,mdss-dsi-panel-timings-phy-v2 = [24 1f 08 09 05 03 04 a0 24 1f 08 09 05 03 04 a0 24 1f 08 09 05 03 04 a0 24 1f 08 09 05 03 04 a0 24 1b 08 09 05 03 04 a0];
};
