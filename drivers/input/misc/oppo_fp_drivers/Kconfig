## drivers/input/misc/oppo_fp_drivers/Kconfig
```kconfig
# SPDX-License-Identifier: GPL-2.0-only
config OPPO_FINGERPRINT
	bool "OPPO fingerprint driver"
	depends on GPIOLIB && INPUT
	help
	  Say Y here to enable OPPO fingerprint support for SDM660 devices.

	  This builds the common fingerprint ID detection (oppo,fp_common),
	  the FPC1020 TEE platform driver, and on R11s devices the Goodix
	  fingerprint platform driver.
```

## drivers/input/misc/oppo_seccommon_drivers/Kconfig
```kconfig
# VENDOR_EDIT
# OPPO secure common driver configuration

config OPPO_SECURE_COMMON
	bool "OPPO secure common"
	help
	  Say Y here to enable OPPO secure common support (secureType, secureSNBound)
```

## drivers/input/touchscreen/oppo_touchscreen/Kconfig
```kconfig
config TOUCHPANEL_NEW_SET_IRQ_WAKE
	bool "OPPO platform tp module used"
	help
	  Say Y here if call enable_irq_wake, can not call disable_irq_nosync

config TOUCHPANEL_OPPO
	bool "OPPO tp module"
	help
	  Say Y here if you have touchscreen module.

config TOUCHPANEL_SYNAPTICS
	bool "TP Synaptics IC enable or not for OPPO"
	---help---
	say Y to enable driver for Touchpanel using Synaptics IC

source "drivers/input/touchscreen/oppo_touchscreen/util_interface/Kconfig"

if TOUCHPANEL_SYNAPTICS
source "drivers/input/touchscreen/oppo_touchscreen/Synaptics/Kconfig"
endif
```

## drivers/input/touchscreen/oppo_touchscreen/Synaptics/S3320/Kconfig
```kconfig
config TOUCHPANEL_SYNAPTICS_S3320
	bool "TP Synaptics S3320 IC enable or not for OPPO"
	---help---
	say Y to enable driver for Touchpanel using synaptics S3320
```

## drivers/input/touchscreen/oppo_touchscreen/Synaptics/S3508/Kconfig
```kconfig
config TOUCHPANEL_SYNAPTICS_S3508
	bool "TP Synaptics S3508 IC enable or not for OPPO"
	---help---
	say Y to enable driver for Touchpanel using synaptics S3508
```

## drivers/input/touchscreen/oppo_touchscreen/Synaptics/S3706/Kconfig
```kconfig
config TOUCHPANEL_SYNAPTICS_S3706
	bool "TP Synaptics S3706 IC enable or not for OPPO"
	---help---
	say Y to enable driver for Touchpanel using synaptics S3706
```

## drivers/platform/oppo/Kconfig
```kconfig
# OPPO configuration options

config MACH_OPPO
	bool "OPPO device"
	depends on ARCH_QCOM
	help
	  Support for OPPO products

config MACH_OPPO_SDM660
	bool "OPPO SDM660"
	depends on ARCH_QCOM
	select MACH_OPPO
	help
	  Support for OPPO SDM660 devices

menu "OPPO board selection"

config MACH_OPPO_R11
  bool "OPPO R11 board"
  select MACH_OPPO_SDM660
  help
    Support for OPPO R11 (16051 16103 16118)

config MACH_OPPO_R11S
  bool "OPPO R11s board"
  select MACH_OPPO_SDM660
  help
    Support for OPPO R11s (17011 17021)

config MACH_OPPO_PAAM00
  bool "OPPO R15 Pro board"
  select MACH_OPPO_SDM660
  help
    Support for OPPO R15 Pro (17081)

# TODO: 17085

config MACH_OPPO_PBCM10
  bool "OPPO R15x & K1 board"
  select MACH_OPPO_SDM660
  help
    Support for OPPO R15x & K1 (18005)

# TODO: 18323

endmenu
```

## drivers/soc/oppo/Kconfig
```kconfig
# SPDX-License-Identifier: GPL-2.0
config OPPO_ARCH_FILE
	bool "for build directory oppo"
	---help---
	say Y to build in

source "drivers/soc/oppo/oppo_project/Kconfig"

source "drivers/soc/oppo/oppo_devinfo/Kconfig"
```

## drivers/soc/oppo/oppo_devinfo/Kconfig
```kconfig
# SPDX-License-Identifier: GPL-2.0
config OPPO_DEVICE_INFO
	bool "config oppo devinfo software"
	depends on OPPO_COMMON_SOFT
	depends on OF && GPIOLIB && PINCTRL
	help
	  define this config to compile devinfo.c for device register
```

## drivers/soc/oppo/oppo_project/Kconfig
```kconfig
# SPDX-License-Identifier: GPL-2.0
config OPPO_COMMON_SOFT
	bool "config oppo common software"
	depends on ARCH_SDM660
	depends on QCOM_SMEM=y
	depends on PROC_FS && SYSFS
	select OPPO_ARCH_FILE
	help
	  define this config to get project version from sharemem.
	  Maybe this value is from CDT or dynamic identify by hardware
	  id.
```
